## src/modules/fc_watchdog/Kconfig
```kconfig
menuconfig MODULES_FC_WATCHDOG
	bool "fc_watchdog"
	default n
	depends on PLATFORM_NUTTX
	---help---
		Hardware watchdog fed only while the flight control loop runs
		(gyro and motor outputs updating). Currently backed by the TI AM67
		RTI8 watchdog (NuttX CONFIG_AM67_RTI8_WDT), whose expiry cuts the
		motor outputs from a FIQ.
```

## src/systemcmds/gem_diag/Kconfig
```kconfig
menuconfig SYSTEMCMDS_GEM_DIAG
	bool "gem_diag"
	default n
	depends on PLATFORM_NUTTX
	---help---
		T3 Gemstone O1 (TI AM67 R5F) diagnostics: PMU event counts,
		memory and register access latency, MCU_MCSPI0 driver timing.
```
